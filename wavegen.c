#include <stdio.h>
#include <math.h>
#include "pico/stdlib.h"
#include "hardware/pwm.h"
#include "hardware/clocks.h"
#include "pirate.h"
#include "system_config.h"
#include "bio.h"
#include "opt_args.h"
#include "ui/ui_prompt.h"
#include "ui/ui_const.h"
#include "ui/ui_term.h"
#include "ui/ui_info.h"

#include "wavegen.h"

#include "hardware/pio.h"
#include "build/wavegen.pio.h"

/* ripped from http://aquaticus.info/pwm-sine-wave */
// VIA: https://gist.github.com/funkfinger/965900
uint8_t  sine_wave[256] = {
  0x80, 0x83, 0x86, 0x89, 0x8C, 0x90, 0x93, 0x96,
  0x99, 0x9C, 0x9F, 0xA2, 0xA5, 0xA8, 0xAB, 0xAE,
  0xB1, 0xB3, 0xB6, 0xB9, 0xBC, 0xBF, 0xC1, 0xC4,
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  0x67, 0x6A, 0x6D, 0x70, 0x74, 0x77, 0x7A, 0x7D
};  





void wavegen_args(opt_args (*args), struct command_result *res)
{
    //all pins to output
    for(uint8_t i=0; i<8; i++)
    {
        bio_output(BIO0+i);
        //bio_put(BIO0+i, 1);    
    }
    
    uint pio_loaded_offset = pio_add_program(pio0, &wavegen_program);
    wavegen_program_init(pio0, 0, pio_loaded_offset, 8);

    //set auto pull and 8 bits in and out...
    
    
    
    //write sin to output

    while(true){
        for(uint16_t i=0; i<256; i++)
        {
            //pio_sm_put_blocking(pio0,0,sine_wave[i]);
            pio_sm_put_blocking(pio0,0,0);
            pio_sm_put_blocking(pio0,0,0x000000ff);
        }
    }


  
    //TODO: make this DMA to PIO/GPIO
}
